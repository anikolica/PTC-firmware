## petalinux/configs/configs/rootfsconfigs/Kconfig.user
```kconfig
menu "user packages " 
config libubootenv-bin  
	 bool "libubootenv-bin"
	 help
	
config genskeleton  
	 bool "genskeleton"
	 help
	
config gpio-demo  
	 bool "gpio-demo"
	 help
	
config openocd  
	 bool "openocd"
	 help
	
config peekpoke  
	 bool "peekpoke"
	 help
	
config regtest  
	 bool "regtest"
	 help
	
endmenu
```
